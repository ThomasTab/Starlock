/*
 Name:		Starlock.ino
 Created:	22/01/2022 11:04:24
 Author:	Thomas Tabuteau
*/

#include "src/StepperControl/StepperControl.h"
#include "src/ESPRotary/ESPRotary.h"
#include <Wire.h>
#include "src/Adafruit_GFX/Adafruit_SSD1306.h"

// Debugging
#define DEBUG_STATE_MACHINE false

// Rotary encoder parameters
#define CLK 2
#define DT 3
#define SW 4

// OLED screen parameters
#define SCREEN_WIDTH 128 // OLED display width, in pixels
#define SCREEN_HEIGHT 64 // OLED display height, in pixels
#define SCREEN_ADDRESS 0x3C
#define OLED_RESET -1 // Reset pin # (or -1 if sharing Arduino reset pin)

// Stepper parameters
#define STEPS_PER_REVOLUTION 47
#define A1 9
#define A2 10
#define B1 11
#define B2 12

// Global variables
const unsigned char PROGMEM splash[] = {
0x00, 0x00, 0x00, 0x00, 0x00, 0x00, 0x00, 0x00, 0x00, 0x00, 0x00, 0x00, 0x00, 0x00, 0x00, 0x00,
0x00, 0x00, 0x00, 0x00, 0x00, 0x40, 0x00, 0x00, 0x00, 0x00, 0x00, 0x00, 0x00, 0x00, 0x00, 0x00,
0x00, 0x00, 0x00, 0x00, 0x10, 0x00, 0x00, 0x00, 0x00, 0x00, 0x00, 0x00, 0x10, 0x00, 0x00, 0x00,
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0x00, 0x00, 0x00, 0x00, 0x00, 0x02, 0x00, 0x01, 0x00, 0x00, 0x00, 0x00, 0x00, 0x00, 0x00, 0x00
};
float speedMultiplier = 1;
int direction = 1;
int state = 0;
ESPRotary r;
Adafruit_SSD1306 display(SCREEN_WIDTH, SCREEN_HEIGHT, &Wire, OLED_RESET);
StepperControl stepper(A1, A2, B1, B2, STEPS_PER_REVOLUTION, speedMultiplier);

void setup() {
    Serial.begin(9600);

    // Setup toggle
    pinMode(12, INPUT_PULLUP);

    // Setup rotary encoder
    r.begin(DT, CLK, 4);
    r.setLeftRotationHandler(showDirection);
    r.setRightRotationHandler(showDirection);
    attachInterrupt(digitalPinToInterrupt(CLK), interruptHandler, CHANGE);
    attachInterrupt(digitalPinToInterrupt(DT), interruptHandler, CHANGE);

    // Setup rotary encoder switch as a pin change interrupt
    pinMode(SW, INPUT);
    *digitalPinToPCMSK(SW) |= bit(digitalPinToPCMSKbit(SW));  // enable pin
    PCIFR |= bit(digitalPinToPCICRbit(SW)); // clear any outstanding interrupt
    PCICR |= bit(digitalPinToPCICRbit(SW)); // enable interrupt for the group

    // Setup OLED screen
    if (!display.begin(SSD1306_SWITCHCAPVCC, SCREEN_ADDRESS)) {
        Serial.println(F("SSD1306 allocation failed"));
        for (;;); // Don't proceed, loop forever
    }

    // Display splashscreen
    display.clearDisplay();
    display.drawBitmap(0, 0, splash, 128, 64, WHITE);
    display.setTextSize(1);
    display.setTextColor(WHITE);
    display.setCursor(43, 40);
    display.print("Ver. 0.1");
    display.display();
    delay(2000);
    stepper.start(1);
}

// on rotary encoder state change trigger analyze
void interruptHandler() {
    r.loop();
}

// on rotary encoder rotation
void showDirection(ESPRotary& r) {
    switch (r.getDirection()) {
    case RE_RIGHT:
        if (speedMultiplier < 8192) {
            speedMultiplier += 2;
        }
        break;
    case RE_LEFT:
        if (speedMultiplier > (0.125)) {
            speedMultiplier -= 2;
        }
        break;
    }
    state = 0;
}

// handle pin change interrupt for switch
ISR(PCINT2_vect)
{
    // Debounce switch
    static unsigned long last_interrupt_time = 0;
    unsigned long interrupt_time = millis();
    if (digitalRead(SW) && (interrupt_time - last_interrupt_time > 200)) {
        // Rotate between -1, 0 and 1 in succession each button press
        direction = ((direction + 2) % 3) - 1;
        state = 1;
    }
    last_interrupt_time = interrupt_time;
}

void loop() {
    stepper.run();
    if (DEBUG_STATE_MACHINE) {
        Serial.print("Current state : " + String(state));
    }

    /*
    * State Machine
    * ###############
    * State 0 : Display current speed multiplier -> default
    * State 1 : Change direction -> 0
    * Default : Don't change display
    * ###############
    * After having displayed the necessary info
    * we don't refresh the display, avoid wasteful
    * computation. Display is refreshed only when
    * outside influence (pin change interrupt and
    * hardware interrupt) change the state
    */
    switch (state) {
    case 0:
        display.clearDisplay();
        display.setTextSize(3);
        display.setTextColor(WHITE);
        display.setCursor(0, 0);
        display.print("x" + String(speedMultiplier * direction));
        display.display();
        stepper.setSpeed(speedMultiplier);
        state = -1;
        break;
    case 1:
        stepper.start(direction);
        state = 0;
        break;
    }

    if (DEBUG_STATE_MACHINE) {
        Serial.println(" | Next state : " + String(state));
    }
}